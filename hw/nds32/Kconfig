## hw/nds32/Kconfig
```kconfig
config NDS32_VIRT
    bool
    default y
    depends on NDS32
    select SERIAL_MM
    select SIFIVE_TEST

config ATBM_HERA
    bool
    select OR_IRQ
    select SERIAL_MM
    select UNIMP
    select SSI
    select SD
    select I2C
    select AT24C
    select ATBM_WIFI
```
