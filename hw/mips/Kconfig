## hw/mips/Kconfig
```kconfig
config MALTA
    bool
    default y
    depends on MIPS
    imply PCNET_PCI
    imply PCI_DEVICES
    imply TEST_DEVICES
    select FDC37M81X
    select GT64120
    select MIPS_CPS
    select PIIX
    select PFLASH_CFI01
    select SERIAL_MM
    select SMBUS_EEPROM

config JAZZ
    bool
    default y
    depends on MIPS64
    select ISA_BUS
    select RC4030
    select I8259
    select I8254
    select I8257
    select PCSPK
    select VGA_MMIO
    select G364FB
    select DP8393X
    select ESP
    select FDC_SYSBUS
    select MC146818RTC
    select PCKBD
    select SERIAL_MM
    select PARALLEL
    select DS1225Y
    select JAZZ_LED

config FULOONG
    bool
    default y
    depends on MIPS64 && !TARGET_BIG_ENDIAN
    imply PCI_DEVICES
    imply TEST_DEVICES
    imply ATI_VGA
    imply RTL8139_PCI
    select PCI_BONITO
    select SMBUS_EEPROM
    select VT82C686

config LOONGSON3V
    bool
    default y
    depends on MIPS64 && !TARGET_BIG_ENDIAN
    imply PCI_DEVICES
    imply TEST_DEVICES
    imply VIRTIO_PCI
    imply VIRTIO_NET
    imply VIRTIO_VGA
    imply QXL if SPICE
    imply USB_OHCI_PCI
    select SERIAL_MM
    select GOLDFISH_RTC
    select LOONGSON_IPI
    select LOONGSON_LIOINTC
    select PCI_EXPRESS_GENERIC_BRIDGE
    select MSI_NONBROKEN
    select FW_CFG_MIPS
    select UNIMP

config MIPS_CPS
    bool
    select MIPS_ITU if TCG

config MIPS_BOSTON
    bool
    default y
    depends on MIPS64 && !TARGET_BIG_ENDIAN && FDT
    imply PCI_DEVICES
    imply TEST_DEVICES
    select DEVICE_TREE
    select FITLOADER
    select MIPS_CPS
    select PCI_EXPRESS_XILINX
    select AHCI_ICH9
    select SERIAL_MM

config INGENIC_T31
    bool
    default y
    depends on MIPS && !TARGET_BIG_ENDIAN && TCG
    select SERIAL_MM
    select UNIMP
    select INGENIC_T31_CPM
    select INGENIC_T31_DDRC
    select INGENIC_T31_SFC
    select INGENIC_T31_GMAC
    select INGENIC_T31_OST
    select INGENIC_T31_SYSOST
    select INGENIC_T31_MSC
    select SDHCI
    select INGENIC_T31_GPIO
    select INGENIC_T31_INTC
    select INGENIC_T31_I2C
    select INGENIC_T31_PDMA
    select USB_DWC2

config INGENIC_A1
    bool
    default y
    depends on MIPS && !TARGET_BIG_ENDIAN && TCG
    select SERIAL_MM
    select UNIMP
    select INGENIC_A1_CPM
    select INGENIC_A1_SFC
    select INGENIC_T31_DDRC
    select INGENIC_A1_XGMAC
    select INGENIC_T31_OST
    select INGENIC_T31_SYSOST
    select INGENIC_T31_MSC
    select INGENIC_T31_GPIO
    select INGENIC_T31_INTC
    select INGENIC_XBURST2_CCU
    select INGENIC_T31_I2C
    select INGENIC_T31_PDMA
    select USB_DWC2
    select AHCI_SYSBUS
    select INGENIC_TCU
    select INGENIC_DTRNG
    select INGENIC_PWM

config INGENIC_T40
    bool
    default y
    depends on MIPS && !TARGET_BIG_ENDIAN && TCG
    select SERIAL_MM
    select UNIMP
    select INGENIC_T40_CPM
    select INGENIC_A1_SFC
    select INGENIC_T31_DDRC
    select INGENIC_T31_GMAC
    select INGENIC_T31_OST
    select INGENIC_T31_SYSOST
    select INGENIC_T31_MSC
    select INGENIC_T31_GPIO
    select INGENIC_T31_INTC
    select INGENIC_XBURST2_CCU
    select INGENIC_T31_I2C
    select INGENIC_T31_PDMA
    select USB_DWC2
    select INGENIC_TCU
    select INGENIC_DTRNG
    select INGENIC_PWM

config FW_CFG_MIPS
    bool
```

## hw/net/Kconfig
```kconfig
config DP8393X
    bool

config NE2000_COMMON
    bool

config NE2000_PCI
    bool
    default y if PCI_DEVICES
    depends on PCI
    select NE2000_COMMON

config EEPRO100_PCI
    bool
    default y if PCI_DEVICES
    depends on PCI
    select NMC93XX_EEPROM

config PCNET_PCI
    bool
    default y if PCI_DEVICES
    depends on PCI
    select PCNET_COMMON

config PCNET_COMMON
    bool

config TULIP
    bool
    default y if PCI_DEVICES
    depends on PCI
    select NMC93XX_EEPROM

config I82596_COMMON
    bool

config E1000_PCI
    bool
    default y if PCI_DEVICES
    depends on PCI

config E1000E_PCI_EXPRESS
    bool
    default y if PCI_DEVICES || PCIE_DEVICES
    depends on PCI_EXPRESS && MSI_NONBROKEN

config IGB_PCI_EXPRESS
    bool
    default y if PCI_DEVICES || PCIE_DEVICES
    depends on PCI_EXPRESS && MSI_NONBROKEN

config RTL8139_PCI
    bool
    default y if PCI_DEVICES
    depends on PCI

config VMXNET3_PCI
    bool
    default y if PCI_DEVICES
    depends on PCI

config SMC91C111
    bool

config LAN9118_PHY
    bool

config LAN9118
    bool
    select LAN9118_PHY
    select PTIMER

config NE2000_ISA
    bool
    default y
    depends on ISA_BUS
    select NE2000_COMMON

config OPENCORES_ETH
    bool

config ALLWINNER_EMAC
    bool

config ALLWINNER_SUN8I_EMAC
    bool

config IMX_FEC
    bool
    select LAN9118_PHY

config CADENCE
    bool

config STELLARIS_ENET
    bool

config LANCE
    bool
    select PCNET_COMMON

config LASI_82596
    bool
    select I82596_COMMON

config SUNHME
    bool

config FTGMAC100
    bool

config SUNGEM
    bool
    depends on PCI

config COLDFIRE
    bool

config XILINX_ETHLITE
    bool

config VIRTIO_NET
    bool
    default y
    depends on VIRTIO

config ETSEC
    bool
    select PTIMER

config ROCKER
    bool
    default y if PCI_DEVICES
    depends on PCI && MSI_NONBROKEN

config CAN_BUS
    bool

config CAN_SJA1000
    bool
    default y if PCI_DEVICES
    select CAN_BUS

config CAN_PCI
    bool
    default y if PCI_DEVICES
    depends on PCI && CAN_SJA1000
    select CAN_BUS

config CAN_CTUCANFD
    bool
    default y if PCI_DEVICES
    select CAN_BUS

config CAN_CTUCANFD_PCI
    bool
    default y if PCI_DEVICES
    depends on PCI && CAN_CTUCANFD
    select CAN_BUS

config CAN_FLEXCAN
    bool
    depends on IMX
    select CAN_BUS

config INGENIC_GMAC
    bool

config AIC_WIFI
    bool
    select SD
    select WIFI_AP
    select WIFI_CLIENT

config ATBM_WIFI
    bool
    select SD
    select WIFI_AP
    select WIFI_CLIENT

config RTL_WIFI
    bool
    select SD
    select WIFI_AP
    select WIFI_CLIENT
    select WIFI_CCMP

config MT7601_WIFI
    bool
    select WIFI_AP
    select WIFI_CLIENT
    select WIFI_CCMP

config WQ9001_WIFI
    bool
    select WIFI_AP
    select WIFI_CLIENT
    select WIFI_CCMP

config BCM_WIFI
    bool
    select SD
    select WIFI_AP
    select WIFI_CLIENT

config HI3881_WIFI
    bool
    select SD
    select WIFI_AP
    select WIFI_CLIENT

config SSV_WIFI
    bool
    select SD
    select WIFI_AP
    select WIFI_CLIENT

config WIFI_AP
    bool
    select WIFI_RSN

config WIFI_CLIENT
    bool
    select WIFI_RSN

config WIFI_CCMP
    bool

config WIFI_RSN
    bool

config INGENIC_A1_XGMAC
    bool
```
